## components/ai-thinker-esp32-a1s/Kconfig.projbuild
```kconfig
menu "Custom Audio Board"

choice CUSTOM_AUDIO_BOARD
    prompt "Select a custom audio board"
    default AI_THINKER_ESP32_A1S_ES8388_VARIANT_7
    help
        Select an audio board to use with the ESP-ADF

    # TODO add more variants, see https://github.com/pschatzmann/arduino-audiokit/tree/main/src/audio_board
    config AI_THINKER_ESP32_A1S_ES8388_VARIANT_7
        bool "Ai Thinker ESP32 A1S Audio Kit (ES8388, variant 7)"
endchoice

config AI_THINKER_ESP32_A1S_AUDIO_KIT_USING_SDCARD
    bool "Use on-board SD card"
    default n
    help
        Choose y to use on-board SD card.
endmenu
```
